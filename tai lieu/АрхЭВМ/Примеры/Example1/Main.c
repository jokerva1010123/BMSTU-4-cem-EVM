/* 	Пример 1.
 	Управление портами ввода/вывода.

    Для правильного связывания модулей отметить
    Options -> Linker -> Use Memory Layout from Target Dialog
*/
                  
#include <LPC24xx.H>                       /* Описание LPC24xx */



void delay(void) {

	unsigned int i;
	for (i=0;i<0xfffff;i++){}
}

int main (void) {
  unsigned int n;
//Конфигурировать функции входов/выходов порта 0 на модуль GPIO  	   
  PINSEL0 	= 0x00000000;
//IODIR0 - Регистр направления ввода вывода (1 - вывод; 0 - ввод)
  IODIR0 = 0x00038000; /* P0.15..17 программируем на вывод, остальные на ввод */
//IOSET0 - Регистр установки порта (1 - установк; 0 - нет изменений)
  IOSET0 = 0x00038000; /* Устанавливаем высокий уровень на выходах (гасим светодиоды) */

  while (1) {          /* Бесконечный цикл */
	//Если PORT0.10=0 то влево, иначе вправо
    if (IOPIN0 & 0x400) {
    	for (n = 0x00008000; n <= 0x00020000; n <<= 1) {
		//Бегущая единица 
		//IOCLR0 - Регистр сброса порта (1 - сброс; 0 - нет изменения)
      		IOCLR0 = n;           /* Сбросить порт */
      		delay();              /* Задержка */
			/* То же, что IOSET0 - Установить состояние порта */
      		*((volatile unsigned long *) 0xE0028004) = 0x00038000;  
		}
    }
	else {
    	for (n = 0x00020000; n >= 0x00008000; n >>= 1) {
		//Бегущая единица 
      		IOCLR0 = n;           /* Сбросить порт */
      		delay();              /* Задержка */
			/* Установить состояние порта */
      		IOSET0 = 0x00038000; 
		} 
	}
  }
}
